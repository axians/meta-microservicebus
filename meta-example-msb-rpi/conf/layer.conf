## meta-example-msb-rpi/conf/layer.conf
```bitbake
# We have a conf and classes directory, add to BBPATH
BBPATH .= ":${LAYERDIR}"

# We have recipes-* directories, add to BBFILES
BBFILES += "${LAYERDIR}/recipes-*/*/*.bb \
            ${LAYERDIR}/recipes-*/*/*.bbappend"

BBFILE_COLLECTIONS += "meta-example-msb-rpi"
BBFILE_PATTERN_meta-example-msb-rpi = "^${LAYERDIR}/"
BBFILE_PRIORITY_meta-example-msb-rpi = "20"

LAYERDEPENDS_meta-example-msb-rpi = "rauc"

LAYERSERIES_COMPAT_meta-example-msb-rpi = "sumo"
```

## meta-microservicebus-compulab/conf/bblayers.conf.sample
```bitbake
LCONF_VERSION = "7"

BBPATH = "${TOPDIR}"
BSPDIR := "${@os.path.abspath(os.path.dirname(d.getVar('FILE', True)) + '/../..')}"

BBFILES ?= ""
BBLAYERS = " \
  ${BSPDIR}/sources/poky/meta \
  ${BSPDIR}/sources/poky/meta-poky \
  \
  ${BSPDIR}/sources/meta-openembedded/meta-oe \
  ${BSPDIR}/sources/meta-openembedded/meta-multimedia \
  \
  ${BSPDIR}/sources/meta-freescale \
  ${BSPDIR}/sources/meta-freescale-3rdparty \
  ${BSPDIR}/sources/meta-freescale-distro \
"


# i.MX Yocto Project Release layers
BBLAYERS += " ${BSPDIR}/sources/meta-fsl-bsp-release/imx/meta-bsp "
BBLAYERS += " ${BSPDIR}/sources/meta-fsl-bsp-release/imx/meta-sdk "
BBLAYERS += " ${BSPDIR}/sources/meta-fsl-bsp-release/imx/meta-ml "

BBLAYERS += "${BSPDIR}/sources/meta-browser"
BBLAYERS += "${BSPDIR}/sources/meta-rust"
BBLAYERS += "${BSPDIR}/sources/meta-openembedded/meta-gnome"
BBLAYERS += "${BSPDIR}/sources/meta-openembedded/meta-networking"
BBLAYERS += "${BSPDIR}/sources/meta-openembedded/meta-python"
BBLAYERS += "${BSPDIR}/sources/meta-openembedded/meta-filesystems"
BBLAYERS += "${BSPDIR}/sources/meta-qt5"

BBLAYERS += "/home/msb/compulab-yocto/sources/meta-microservicebus/meta-microservicebus-compulab"

BBLAYERS += " \
	${BSPDIR}/sources/meta-compulab \
	${BSPDIR}/sources/meta-compulab-bsp/meta-bsp \
	${BSPDIR}/sources/meta-bsp-imx7 \
	${BSPDIR}/sources/meta-openembedded/meta-xfce \
"

BBLAYERS += "/home/msb/compulab-yocto/sources/meta-microservicebus/meta-microservicebus-node"
BBLAYERS += "/home/msb/compulab-yocto/sources/meta-microservicebus/meta-microservicebus-dam"
BBLAYERS += "/home/msb/compulab-yocto/sources/meta-rauc"
BBLAYERS += "/home/msb/compulab-yocto/sources/meta-virtualization"
```

## meta-microservicebus-compulab/conf/layer.conf
```bitbake
# We have a conf and classes directory, add to BBPATH
BBPATH .= ":${LAYERDIR}"

# We have recipes-* directories, add to BBFILES
BBFILES += "${LAYERDIR}/recipes-*/*/*.bb \
            ${LAYERDIR}/recipes-*/*/*.bbappend"

BBFILE_COLLECTIONS += "meta-microservicebus-compulab"
BBFILE_PATTERN_meta-microservicebus-compulab = "^${LAYERDIR}/"
BBFILE_PRIORITY_meta-microservicebus-compulab = "6"

LAYERDEPENDS_meta-microservicebus-compulab = "core"
LAYERSERIES_COMPAT_meta-microservicebus-compulab = "warrior"
MSB_CL-SOM-IMX7_LAYERDIR := "${LAYERDIR}"
```

## meta-microservicebus-compulab/conf/local.conf.sample
```bitbake
MACHINE ??= 'cl-som-imx7'
DISTRO ?= 'fsl-imx-fb'
PACKAGE_CLASSES = 'package_deb package_tar'
EXTRA_IMAGE_FEATURES ?= "debug-tweaks"
USER_CLASSES ?= "buildstats image-mklibs image-prelink"
PATCHRESOLVE = "noop"
BB_DISKMON_DIRS ??= "\
    STOPTASKS,${TMPDIR},1G,100K \
    STOPTASKS,${DL_DIR},1G,100K \
    STOPTASKS,${SSTATE_DIR},1G,100K \
    STOPTASKS,/tmp,100M,100K \
    ABORT,${TMPDIR},100M,1K \
    ABORT,${DL_DIR},100M,1K \
    ABORT,${SSTATE_DIR},100M,1K \
    ABORT,/tmp,10M,1K"
PACKAGECONFIG_append_pn-qemu-system-native = " sdl"
PACKAGECONFIG_append_pn-nativesdk-qemu = " sdl"
CONF_VERSION = "1"

DL_DIR ?= "${BSPDIR}/downloads/"
ACCEPT_FSL_EULA = "1"
CORE_IMAGE_EXTRA_INSTALL += " dhcp-client rng-tools  cl-uboot cl-deploy cl-camera cl-stest memtester htop iotop tmux iperf3 stress-ng  bt-start video-mode  u-boot-fw-utils  kernel-modules firmware-imx-sdma linux-firmware-wl18xx linux-firmware-wlcommon linux-firmware-ti-connectivity-license bluez5 wpa-supplicant wvdial wvdial-compulab openssl-bin i2c-tools"
IMAGE_FEATURES += " package-management ssh-server-openssh "
LICENSE_FLAGS_WHITELIST = "commercial"
DISTRO_FEATURES_append = " polkit"
PREFERRED_RPROVIDER_u-boot-fw-utils = "u-boot-fw-utils"

# Make it use for core-images only
# These package cause a root image build conflict with gui images
# CORE_IMAGE_EXTRA_INSTALL += " modemmanager networkmanager "

# Users' Configurations

WKS_FILE = "microservicebus-uboot.wks.in"

# Set fixed size rootf to not break rauc update
IMAGE_ROOTFS_EXTRA_SPACE = "0"
IMAGE_ROOTFS_SIZE = "1048576"
IMAGE_INSTALL_append = " u-boot-script-compulab"

IMAGE_INSTALL_append = " bluez5"
IMAGE_INSTALL_append = " wpa-supplicant"
IMAGE_INSTALL_append = " usbutils"
IMAGE_INSTALL_append = " modemmanager wvdial"
IMAGE_INSTALL_append = " networkmanager"
PACKAGECONFIG_append_pn-networkmanager = " modemmanager"

# microservicebus-node configuration
IMAGE_INSTALL_append = " microservicebus-node"
IMAGE_INSTALL_append = " microservicebus-node-service"
IMAGE_INSTALL_append = " microservicebus-node-user"
#IMAGE_INSTALL_append = " serialport"
IMAGE_INSTALL_append = " packagegroup-microservicebus-build"
IMAGE_INSTALL_append = " base-files"
IMAGE_INSTALL_append = " compulab-init"

MSB_NODE_USER ?= "msb"
MSB_NODE_GROUP ?= "msb"
MSB_HOME_DIR_PATH ?= ""
MSB_USER_GROUPS ?= "tty,dialout"
MSB_USER_UID ?= "350"
MSB_NODE_ARG ?= ""
MSB_NODE_WORK_DIR ?= "/usr/lib/node/microservicebus-node"
MSB_DEP ?= ""

# Include microServiceBus-DAM and set parameters for integration with mSB-core
IMAGE_INSTALL_append = " microservicebus-dam"
IMAGE_INSTALL_append = " microservicebus-dam-service"
IMAGE_INSTALL_append = " microservicebus-dam-scheduled-service"
MSB_DEP_append = " microservicebus-dam"
MSB_USER_GROUPS_append = ",msbdam"

# RAUC
IMAGE_INSTALL_append = " rauc"

# DOCKER
#DISTRO_FEATURES_append = " virtualization"
#IMAGE_INSTALL_append = " docker-ce"
#ENABLE_UART = "1"
#MSB_USER_GROUPS_append = ",docker"
#MSB_DEP_append = " docker-ce"

# GPIO
IMAGE_INSTALL_append = " gpio"
MSB_USER_GROUPS_append = ",gpio"
MSB_DEP_append = " gpio"

# Specify home directory for msb user.
MSB_HOME_DIR_PATH = "/data/home/${MSB_NODE_USER}"

# Chose custom boot script for dual partitions
IBOOTSCRIPT = "rauc-bootscr"

# Add kernel and device tree to rootfs image in /boot/
IMAGE_INSTALL_append = " kernel kernel-devicetree"

COMPULAB_ROOT_PASSWD = ""
```

## meta-microservicebus-dam/conf/layer.conf
```bitbake
# We have a conf and classes directory, add to BBPATH
BBPATH .= ":${LAYERDIR}"

# We have recipes-* directories, add to BBFILES
BBFILES += "${LAYERDIR}/recipes-*/*/*.bb \
            ${LAYERDIR}/recipes-*/*/*.bbappend"

BBFILE_COLLECTIONS += "meta-microservicebus-dam"
BBFILE_PATTERN_meta-microservicebus-dam = "^${LAYERDIR}/"
BBFILE_PRIORITY_meta-microservicebus-dam = "6"

LAYERDEPENDS_meta-microservicebus-dam = "core"
LAYERSERIES_COMPAT_meta-microservicebus-dam = "kirkstone"
```

## meta-microservicebus-node/conf/layer.conf
```bitbake
# We have a conf and classes directory, add to BBPATH
BBPATH .= ":${LAYERDIR}"

# We have recipes-* directories, add to BBFILES
BBFILES += "${LAYERDIR}/recipes-*/*/*.bb \
            ${LAYERDIR}/recipes-*/*/*.bbappend"

BBFILE_COLLECTIONS += "meta-microservicebus-node"
BBFILE_PATTERN_meta-microservicebus-node= "^${LAYERDIR}/"
BBFILE_PRIORITY_meta-microservicebus-node= "16"

LAYERDEPENDS_meta-microservicebus-node = "openembedded-layer"

LAYERSERIES_COMPAT_meta-microservicebus-node = "thud sumo"

# Additional license directories.
LICENSE_PATH += "${LAYERDIR}/files/common-licenses"
SPDXLICENSEMAP[Unlicensev1] = "Unlicense"
SPDXLICENSEMAP[WTFPLv1] = "WTFPL"
```

## meta-microservicebus-raspberrypi/conf/bblayers.conf.sample
```bitbake
# POKY_BBLAYERS_CONF_VERSION is increased each time build/conf/bblayers.conf
# changes incompatibly
POKY_BBLAYERS_CONF_VERSION = "2"

BBPATH = "${TOPDIR}"
BBFILES ?= ""

BBLAYERS ?= " \
  /home/yocto/yocto/source/poky/meta \
  /home/yocto/yocto/source/poky/meta-poky \
  /home/yocto/yocto/source/poky/meta-yocto-bsp \
  /home/yocto/yocto/source/meta-openembedded/meta-oe \
  /home/yocto/yocto/source/meta-openembedded/meta-filesystems \
  /home/yocto/yocto/source/meta-openembedded/meta-networking \
  /home/yocto/yocto/source/meta-openembedded/meta-python \
  /home/yocto/yocto/source/meta-microservicebus/meta-microservicebus-node \
  /home/yocto/yocto/source/meta-microservicebus/meta-microservicebus-raspberrypi \
  /home/yocto/yocto/source/meta-raspberrypi \
  /home/yocto/yocto/source/meta-rauc \
  "
  
```

## meta-microservicebus-raspberrypi/conf/layer.conf
```bitbake
# We have a conf and classes directory, add to BBPATH
BBPATH .= ":${LAYERDIR}"

# We have recipes-* directories, add to BBFILES
BBFILES += "${LAYERDIR}/recipes-*/*/*.bb \
            ${LAYERDIR}/recipes-*/*/*.bbappend"

BBFILE_COLLECTIONS += "meta-microservicebus-raspberrypi"
BBFILE_PATTERN_meta-microservicebus-raspberrypi = "^${LAYERDIR}/"
BBFILE_PRIORITY_meta-microservicebus-raspberrypi = "20"

LAYERDEPENDS_meta-microservicebus-raspberrypi = "rauc raspberrypi"

LAYERSERIES_COMPAT_meta-microservicebus-raspberrypi = "warrior thud sumo"

MSB_RASPBERRYPI_LAYERDIR := "${LAYERDIR}"
```

## meta-microservicebus-raspberrypi/conf/local.conf.sample
```bitbake
# An sample config to build an RPi image supporting microServiceBus and
# firmware update using RAUC

CONF_VERSION = "1"

# Default to build for RPi 3
MACHINE ?= "raspberrypi3"

# Use poky as distro
DISTRO ?= "poky"

# Create an rpi-sdimg for writing to SD-Card
IMAGE_FSTYPES = "tar.bz2 ext4 rpi-sdimg"

# Use ext4 as rootfs as that is supported by RAUC
SDIMG_ROOTFS_TYPE = "ext4"

# Set systemd as init and daemon manager
DISTRO_FEATURES_append = " systemd"
DISTRO_FEATURES_BACKFILL_CONSIDERED += "sysvinit"
VIRTUAL-RUNTIME_init_manager = "systemd"
VIRTUAL-RUNTIME_initscripts = "systemd-compat-units"

# Debian package format for packages
PACKAGE_CLASSES ?= "package_deb"

# Uncomment debug-tweaks below to add support for blank root password
#EXTRA_IMAGE_FEATURES += " debug-tweaks"

# Some default Yocto settings
USER_CLASSES ?= "buildstats image-mklibs image-prelink"

PATCHRESOLVE = "noop"

BB_DISKMON_DIRS ??= "\
    STOPTASKS,${TMPDIR},1G,100K \
    STOPTASKS,${DL_DIR},1G,100K \
    STOPTASKS,${SSTATE_DIR},1G,100K \
    STOPTASKS,/tmp,100M,100K \
    ABORT,${TMPDIR},100M,1K \
    ABORT,${DL_DIR},100M,1K \
    ABORT,${SSTATE_DIR},100M,1K \
    ABORT,/tmp,10M,1K"

PACKAGECONFIG_append_pn-qemu-native = " sdl"

PACKAGECONFIG_append_pn-nativesdk-qemu = " sdl"

# Use U-Boot as bootloader to support RAUC firmware updates
RPI_USE_U_BOOT = "1"

# Set serial console
SERIAL_CONSOLE = ""

# Specify user for microservicebus-node
MSB_NODE_USER = "msb"
MSB_NODE_GROUP = "msb"
MSB_NODE_ARG = "-w"

# Specify home directory for msb user.
MSB_HOME_DIR_PATH = "/data/home/${MSB_NODE_USER}"

# Specify default SSID and password for WiFi
RPI_WIFI_SSID = "SSID"
RPI_WIFI_PSK = "PASSW"

# Uncomment setting below to add support for Azure IoT-Edge
#DISTRO_FEATURES_append = " virtualization"

# Workaround as IoT-Edge not support latest rust version in meta-rust
#PREFERRED_VERSION_rust = "1.34.2"
#PREFERRED_VERSION_rust-native = "1.34.2"
#PREFERRED_VERSION_cargo = "1.34.2"
#PREFERRED_VERSION_cargo-native = "1.34.2"
#PREFERRED_VERSION_libstd-rs = "1.34.2"
#PREFERRED_VERSION_rust-cross = "1.34.2"
#PREFERRED_VERSION_rust-llvm = "1.34.2"
#PREFERRED_VERSION_rust-llvm-native = "1.34.2"
```

## meta-microservicebus/conf/layer.conf
```bitbake
# We have a conf and classes directory, add to BBPATH
BBPATH .= ":${LAYERDIR}"

# We have recipes-* directories, add to BBFILES
BBFILES += "${LAYERDIR}/recipes-*/*/*.bb \
            ${LAYERDIR}/recipes-*/*/*.bbappend"

BBFILE_COLLECTIONS += "meta-microservicebus"
BBFILE_PATTERN_meta-microservicebus= "^${LAYERDIR}/"
BBFILE_PRIORITY_meta-microservicebus= "16"

LAYERDEPENDS_meta-microservicebus = "openembedded-layer"

LAYERSERIES_COMPAT_meta-microservicebus = "sumo"
```
